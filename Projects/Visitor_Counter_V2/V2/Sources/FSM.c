/******************************************************************************
 * @file    fsm.c
 * @brief   Finite state machine for visitor entry and exit direction control.
 *
 *          Processes sensor events generated by the EXTI driver and determines
 *          whether a person is entering, exiting, or moving in the wrong
 *          direction.
 *
 *          Valid sequences:
 *          S1 -> S2 : Valid entry
 *          S3 -> S4 : Valid exit
 *
 *          Invalid sequences:
 *          S2 -> S1 : Entry direction warning
 *          S4 -> S3 : Exit direction warning
 *
 *          A timeout prevents the FSM from remaining indefinitely in a
 *          partially completed sensor sequence.
 *
 * @author  Balaji M
 * @target  STM32U083RC
 ******************************************************************************/

#include "fsm.h"
#include "EXTI.h"
#include "SysTick.h"
#include "gpio.h"
#include "EEPROM.h"
#include "display.h"

#define FSM_TIMEOUT_MS    2000U
#define WARNING_TIME_MS   1000U


/* Current FSM state and timing information */
static FSM_State_t CurrentState = FSM_IDLE;
static uint32_t StateStartTime = 0;


/*
 * Identifies which warning output is currently active.
 * This allows the common warning timeout handler to switch off only the
 * LED associated with the detected wrong direction.
 */
typedef enum
{
    WARNING_NONE,
    WARNING_ENTRY,
    WARNING_EXIT
} WarningType_t;

static WarningType_t WarningType = WARNING_NONE;
static uint32_t WarningStartTime = 0;


/* Visitor counters maintained by the main application */
extern volatile uint16_t InCount;
extern volatile uint16_t OutCount;
extern volatile uint16_t Present;


/******************************************************************************
 * @brief Initializes the visitor counter state machine.
 *
 *        Starts the FSM in the idle state and clears any pending warning
 *        state or warning timeout.
 ******************************************************************************/
void FSM_Init(void)
{
    CurrentState = FSM_IDLE;
    StateStartTime = SysTick_ms;

    WarningType = WARNING_NONE;
    WarningStartTime = 0;
}


/******************************************************************************
 * @brief Processes sensor events and advances the visitor counter FSM.
 *
 *        Sensor flags are generated by the EXTI driver. The FSM interprets
 *        the order in which the sensors are triggered:
 *
 *        S1 -> S2 : Entry is accepted and IN/PRESENT are incremented.
 *        S3 -> S4 : Exit is accepted and OUT/PRESENT are updated.
 *        S2 -> S1 : Entry warning is generated.
 *        S4 -> S3 : Exit warning is generated.
 *
 *        If the expected second sensor is not triggered within the FSM
 *        timeout period, the current sequence is cancelled and the FSM
 *        returns to the idle state.
 ******************************************************************************/
void FSM_Process(void)
{
    switch (CurrentState)
    {
        /* Wait for the first sensor activation */
        case FSM_IDLE:

            if (S1_Flag)
            {
                S1_Flag = 0;

                CurrentState = FSM_ENTRY_S1;
                StateStartTime = SysTick_ms;
            }
            else if (S2_Flag)
            {
                S2_Flag = 0;

                CurrentState = FSM_ENTRY_S2;
                StateStartTime = SysTick_ms;
            }
            else if (S3_Flag)
            {
                S3_Flag = 0;

                CurrentState = FSM_EXIT_S3;
                StateStartTime = SysTick_ms;
            }
            else if (S4_Flag)
            {
                S4_Flag = 0;

                CurrentState = FSM_EXIT_S4;
                StateStartTime = SysTick_ms;
            }

            break;


        /* S1 was triggered first: wait for S2 to confirm entry */
        case FSM_ENTRY_S1:

            if (S2_Flag)
            {
                S2_Flag = 0;

                /* Valid entry */
                InCount++;
                Present++;

                EEPROM_WriteUint16(EEPROM_IN_COUNT_ADDR, InCount);

                Display_UpdateVisitorCounts(InCount,
                                            OutCount,
                                            Present);

                Buzzer_Beep(500);

                CurrentState = FSM_IDLE;
            }
            else if ((SysTick_ms - StateStartTime) >= FSM_TIMEOUT_MS)
            {
                /* Cancel incomplete entry sequence */
                CurrentState = FSM_IDLE;
            }

            break;


        /* S2 was triggered first: detect wrong entry direction */
        case FSM_ENTRY_S2:

            if (S1_Flag)
            {
                S1_Flag = 0;

                /* Wrong entry direction */
                Buzzer_On();
                Entry_Warning_LED_On();

                WarningType = WARNING_ENTRY;
                WarningStartTime = SysTick_ms;

                CurrentState = FSM_IDLE;
            }
            else if ((SysTick_ms - StateStartTime) >= FSM_TIMEOUT_MS)
            {
                /* Cancel incomplete sequence */
                CurrentState = FSM_IDLE;
            }

            break;


        /* S3 was triggered first: wait for S4 to confirm exit */
        case FSM_EXIT_S3:

            if (S4_Flag)
            {
                S4_Flag = 0;

                /* Valid exit */
                OutCount++;

                /*
                 * Prevent occupancy from underflowing if an exit is detected
                 * while the room is already empty.
                 */
                if (Present > 0)
                {
                    Present--;
                }

                EEPROM_WriteUint16(EEPROM_OUT_COUNT_ADDR, OutCount);

                Display_UpdateVisitorCounts(InCount,
                                            OutCount,
                                            Present);

                CurrentState = FSM_IDLE;
            }
            else if ((SysTick_ms - StateStartTime) >= FSM_TIMEOUT_MS)
            {
                /* Cancel incomplete exit sequence */
                CurrentState = FSM_IDLE;
            }

            break;


        /* S4 was triggered first: detect wrong exit direction */
        case FSM_EXIT_S4:

            if (S3_Flag)
            {
                S3_Flag = 0;

                /* Wrong exit direction */
                Buzzer_On();
                Exit_Warning_LED_On();

                WarningType = WARNING_EXIT;
                WarningStartTime = SysTick_ms;

                CurrentState = FSM_IDLE;
            }
            else if ((SysTick_ms - StateStartTime) >= FSM_TIMEOUT_MS)
            {
                /* Cancel incomplete sequence */
                CurrentState = FSM_IDLE;
            }

            break;


        /* Recover safely from an unexpected FSM state */
        default:

            CurrentState = FSM_IDLE;

            break;
    }


    /*
     * Handle warning timeout independently of the main FSM state.
     * Warnings remain active for WARNING_TIME_MS before the buzzer and
     * corresponding warning LED are switched off.
     */
    if (WarningStartTime != 0 &&
        (SysTick_ms - WarningStartTime) >= WARNING_TIME_MS)
    {
        Buzzer_Off();

        if (WarningType == WARNING_ENTRY)
        {
            Entry_Warning_LED_Off();
        }
        else if (WarningType == WARNING_EXIT)
        {
            Exit_Warning_LED_Off();
        }

        WarningType = WARNING_NONE;
        WarningStartTime = 0;
    }
}
